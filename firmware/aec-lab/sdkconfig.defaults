## firmware/aec-lab/sdkconfig.defaults
```kconfig
CONFIG_IDF_TARGET="esp32s3"
CONFIG_SPIRAM=y
CONFIG_SPIRAM_MODE_QUAD=n
CONFIG_SPIRAM_MODE_OCT=y
CONFIG_ESP_DEFAULT_CPU_FREQ_MHZ_240=y
CONFIG_FREERTOS_HZ=1000
CONFIG_COMPILER_OPTIMIZATION_PERF=y
CONFIG_ESPTOOLPY_FLASHSIZE_8MB=y
CONFIG_ESPTOOLPY_FLASHSIZE="8MB"
CONFIG_ESP_MAIN_TASK_STACK_SIZE=16384
CONFIG_CODEC_I2C_BACKWARD_COMPATIBLE=n
```

## firmware/echo-pyramid/main/Kconfig.projbuild
```kconfig
menu "Hermes IoT Firmware"

config HERMES_IOT_WIFI_SSID
    string "Wi-Fi SSID"
    default ""
    help
        SSID for the Wi-Fi network the Echo Pyramid should join.

config HERMES_IOT_WIFI_PASSWORD
    string "Wi-Fi password"
    default ""
    help
        Password for the Wi-Fi network.

config HERMES_IOT_GATEWAY_BASE_URL
    string "Gateway base URL"
    default "http://192.168.1.2:8000"
    help
        Base URL for the Hermes IoT gateway, for example http://192.168.1.2:8000.

config HERMES_IOT_DEVICE_ID
    string "Device ID"
    default "echo-pyramid-dev"
    help
        Stable device identifier reported to the gateway.

config HERMES_IOT_FIRMWARE_VERSION
    string "Firmware version"
    default "0.1.0"
    help
        Firmware version string reported during device claim.

config HERMES_IOT_BOOT_AEC_PROBE
    bool "Run AEC ground-truth probe on boot"
    default n
    help
        Play a local test tone after audio init and log MIC/ref/AEC probe
        metrics before starting the normal gateway loop. Intended only for
        Echo Pyramid AEC bring-up.

endmenu
```

## firmware/echo-pyramid/sdkconfig.defaults
```kconfig
CONFIG_IDF_TARGET="esp32s3"
CONFIG_SPIRAM=y
CONFIG_SPIRAM_MODE_QUAD=n
CONFIG_SPIRAM_MODE_OCT=y
CONFIG_ESP_DEFAULT_CPU_FREQ_MHZ_240=y
CONFIG_FREERTOS_HZ=1000
CONFIG_COMPILER_OPTIMIZATION_PERF=y
CONFIG_ESPTOOLPY_FLASHSIZE_8MB=y
CONFIG_ESPTOOLPY_FLASHSIZE="8MB"
CONFIG_PARTITION_TABLE_CUSTOM=y
CONFIG_PARTITION_TABLE_CUSTOM_FILENAME="partitions.csv"
CONFIG_PARTITION_TABLE_FILENAME="partitions.csv"
CONFIG_PARTITION_TABLE_OFFSET=0x8000
CONFIG_ESP_MAIN_TASK_STACK_SIZE=16384
CONFIG_CODEC_I2C_BACKWARD_COMPATIBLE=n
CONFIG_MBEDTLS_SSL_PROTO_DTLS=y
CONFIG_MBEDTLS_SSL_DTLS_SRTP=y

# Local "hey willow" wake word model.
CONFIG_MODEL_IN_FLASH=y
CONFIG_SR_WN_WN9_HEYWILLOW_TTS=y
```
